## CMakeLists.txt
```
# BUSBRIDGE-RT firmware
#
# Built as a freestanding MCUXpresso SDK example: the sources live here, the
# SDK stays untouched at E:/RT1186/sdk/mcuxsdk. That is the same separation the
# STM32 tree kept between firmware/ and its lib/ clones of ST's HAL, and for the
# same reason - a vendor tree with local edits in it is a tree you cannot update.
#
#   west build -b frdmimxrt1186 E:/BusBridge-RT/firmware \
#       --toolchain armgcc --config debug -Dcore_id=cm33 \
#       -DBB_PROFILE=bridge -d E:/BusBridge-RT/build/bridge
#
# BB_PROFILE selects which image is built. The two share the board layer, the
# transports and the command parser; they differ in what they do with the pins.
# See firmware/inc/bb_profile.h.

cmake_minimum_required(VERSION 3.22.0)

include(${SdkRootDirPath}/cmake/extension/mcux.cmake)

set(BB_ROOT ${CMAKE_CURRENT_LIST_DIR})

if(NOT DEFINED BB_PROFILE)
    set(BB_PROFILE bridge)
endif()
# Three images, not two. `capture` is the CM7 half of the sniffer and shares the
# board layer and the capture format with the others but none of the command
# protocol - it answers the link, not the host.
if(NOT BB_PROFILE MATCHES "^(bridge|peripheral|capture)$")
    message(FATAL_ERROR "BB_PROFILE must be bridge, peripheral or capture, got '${BB_PROFILE}'")
endif()

# The board directory name is the -DBB_BOARD value, exactly as in the STM32
# tree: adding a board means adding a directory, not editing a list here.
if(NOT DEFINED BB_BOARD)
    set(BB_BOARD frdm_imxrt1186)
endif()
set(BB_BOARD_DIR ${BB_ROOT}/boards/${BB_BOARD})
if(NOT EXISTS ${BB_BOARD_DIR}/bb_board_def.h)
    message(FATAL_ERROR "no such board: ${BB_BOARD_DIR}/bb_board_def.h is missing")
endif()
include(${BB_BOARD_DIR}/board.cmake)

# The SDK appends PROJECT_BOARD_PORT_PATH to SdkRootDirPath, so it has to be
# relative to the SDK even though this tree lives outside it. Computed rather
# than written by hand, because a hand-written "../../.." silently stops being
# right the moment either tree moves.
if(NOT CMAKE_CURRENT_LIST_DIR MATCHES "^([A-Za-z]:)" OR NOT SdkRootDirPath MATCHES "^([A-Za-z]:)")
    set(BB_SAME_DRIVE TRUE)
else()
    string(REGEX MATCH "^([A-Za-z]:)" BB_DRIVE_APP ${CMAKE_CURRENT_LIST_DIR})
    string(REGEX MATCH "^([A-Za-z]:)" BB_DRIVE_SDK ${SdkRootDirPath})
    string(TOUPPER "${BB_DRIVE_APP}" BB_DRIVE_APP)
    string(TOUPPER "${BB_DRIVE_SDK}" BB_DRIVE_SDK)
    if(BB_DRIVE_APP STREQUAL BB_DRIVE_SDK)
        set(BB_SAME_DRIVE TRUE)
    else()
        set(BB_SAME_DRIVE FALSE)
    endif()
endif()
if(NOT BB_SAME_DRIVE)
    message(FATAL_ERROR
        "This tree (${CMAKE_CURRENT_LIST_DIR}) and the SDK (${SdkRootDirPath}) are on "
        "different drives. The SDK builds the board port path by appending to its own "
        "root, which cannot express that. Put both on one drive.")
endif()
file(RELATIVE_PATH BB_PORT_REL ${SdkRootDirPath} ${BB_BOARD_DIR}/port)

project(busbridge_rt LANGUAGES C CXX ASM
        PROJECT_BOARD_PORT_PATH ${BB_PORT_REL})

include(${SdkRootDirPath}/CMakeLists.txt)

# ---- sources -------------------------------------------------------------
if(BB_PROFILE STREQUAL "capture")
    # The capture core links none of the host transports or the command parser.
    # It talks to the controller core and to FlexIO, and that is all.
    mcux_add_source(
        BASE_PATH ${BB_ROOT}
        SOURCES
            cm7/capture_main.c
            cm7/dec_i3c.c       # the native I3C decoder, kept out of the I2C one
            src/bb_image.c      # for bb_image_crc32: every record carries one
    )
else()
    # Common to both host-facing images: the transports, the command pump, the
    # board layer.
    mcux_add_source(
        BASE_PATH ${BB_ROOT}
        SOURCES
            src/main.c
            src/bb_board.c
            src/bb_cmd.c
            src/bb_console.c
            src/bb_image.c
            src/bb_link.c
            src/bb_io.c
            src/bb_trace.c
            src/bb_usb.c
    )
endif()

# The profile's own sources. Listed per profile rather than globbed: a glob
# would silently pick up the _stm32_reference/ files that are deliberately not
# in the build yet.
if(BB_PROFILE STREQUAL "capture")
    # no profile sources: cm7/capture_main.c above is the whole image
elseif(BB_PROFILE STREQUAL "bridge")
    mcux_add_source(
        BASE_PATH ${BB_ROOT}
        SOURCES
            profiles/bridge/bridge.c
            profiles/bridge/bb_i2c.c
            profiles/bridge/bb_i3c.c
            profiles/bridge/bb_spi.c
            profiles/bridge/bb_mdio.c
            profiles/bridge/bb_uart.c
            profiles/bridge/bb_can.c
            profiles/bridge/bb_sniff.c
            profiles/bridge/bb_net.c
    )
else()
    mcux_add_source(
        BASE_PATH ${BB_ROOT}
        SOURCES
            profiles/peripheral/peripheral.c
            profiles/peripheral/bb_ee.c
            profiles/peripheral/bb_ee_cmd.c
            profiles/peripheral/bb_ee_i2c.c
            profiles/peripheral/bb_ee_spi.c
            profiles/peripheral/bb_ee_i3c.c
            profiles/peripheral/bb_ee_mdio.c
    )
endif()

mcux_add_include(
    BASE_PATH ${BB_ROOT}
    INCLUDES inc shared boards/${BB_BOARD}
)

# The RAM target is the only one with a memory budget, so it is the only one that
# is optimized.
#
# The SDK gives every *_debug configuration "-g -O0" (arch/arm/target/targets.cmake)
# and every *_release "-Os". That is right for the XIP configurations, which have
# 8 MB of flash and use 2% of it, and impossible for this one: `debug` links into
# 127 KB of ITCM, and at -O0 the bridge profile does not fit - it overflowed
# m_text by 496 bytes once the capture decoder and the event path landed.
#
# -Og rather than -Os on purpose. This is still the debug configuration and is
# what a debugger is pointed at, so the optimization that exists to stay
# debuggable is the one to reach for; -Os is the fallback if -Og stops fitting.
# Appended after the SDK's own flags, so gcc's last -O wins, and -g is untouched.
#
# Scoped deliberately, and the scope matters more than it looks:
#
#   - bridge only. The peripheral profile fits at -O0 (62%) and the capture core
#     has 255 KB of its own, so neither needs this.
#   - the RAM configuration only. The XIP pair is the primary build and the one
#     `reload.ps1` flashes, and its measurements - the 16 M samples/s intake
#     budget, the transport figures - were all taken at -O0. Optimizing the CM7
#     would change the cost of cap_poll() and the settle loops that pace the
#     generator, which is exactly what that budget measures, so it would
#     invalidate the number rather than improve it.
#
# The consequence to know about: the RAM and XIP images are now built at
# different optimization levels, so they are genuinely different binaries. That
# is what a 127 KB budget costs.
if(BB_PROFILE STREQUAL "bridge" AND CMAKE_BUILD_TYPE STREQUAL "debug")
    mcux_add_armgcc_configuration(CC "-Og")
endif()

# The capture core is built for speed, and until now it was not built for
# anything: it inherited the SDK's debug "-O0" because it has 255 KB to itself
# and nothing ever pushed on the size.
#
# Size was the wrong question. Every sampling limit in this project is the cost
# of the per-sample loop in cap_consume() - the intake budget, the pin-clocked
# overruns above 3 MHz, the whole ceiling - and that loop was compiled with no
# optimization at all. An earlier note here reasoned that optimizing this core
# "would change the cost of cap_poll() ... so it would invalidate the number
# rather than improve it". It does invalidate the number. That is the point: the
# budget is a measurement of this code, so making the code faster is supposed to
# move it, and the measurement is cheap to repeat.
#
# -O2 rather than -O3: the hot loop is bit tests and a comparison, not anything
# -O3's extra vectorization and unrolling would help, and -O2 keeps the image
# and the stack frames closer to what has been debugged.
#
# -flto because the hot loop crosses a translation unit.
#
# cap_consume() spends its per-bit budget calling dec_i3c_bit(), which lives in
# dec_i3c.c, so without link-time optimisation every bit pays a real call into
# another object file. Measured with the cycle counter: a pin-clocked word costs
# about 418 cycles for eight bits against a 507-cycle budget at 12.5 MHz, and
# the call is the part that cannot be optimised away from inside one file.
if(BB_PROFILE STREQUAL "capture")
    mcux_add_armgcc_configuration(CC "-O2 -flto")
    mcux_add_armgcc_configuration(LD "-flto -O2")
endif()

# The board header and its pin map are reached through these two defines rather
# than an #if chain, so nothing outside boards/<name>/ knows a board exists.
mcux_add_macro(
    CC "-DBB_BOARD_HEADER=\"${BB_BOARD_DIR}/board.h\" \
       -DBB_BOARD_PINMAP=\"${BB_BOARD_DIR}/pinmap.inc\" \
       -DBB_PROFILE_${BB_PROFILE}=1        -DUSB_DEVICE_CONFIG_LPM_L1=1        -DI2C_RETRY_TIMES=1000000        -DI3C_RETRY_TIMES=1000000        -DUART_RETRY_TIMES=1000000        -D__USE_SHMEM"
)

# UART_RETRY_TIMES does for fsl_lpuart.c what I2C_RETRY_TIMES does for LPI2C,
# and it is needed for a specific reason rather than symmetry.
#
# LPUART_WriteBlocking() waits for the transmitter to drain. With hardware flow
# control enabled and nothing wired to CTS, the pad pulls high - CTS_B is active
# low, so that reads as "peer not ready" - and the transmitter correctly refuses
# to send. The wait then never ends and the command loop is gone. That is not a
# flow-control bug: it is what flow control means. It is a bounded-wait bug.
#
# Found exactly that way: UART:CFG with rtscts succeeded and the *next* command
# timed out, because the reply to it could not be transmitted.
#
# I2C_RETRY_TIMES bounds every polled wait in fsl_lpi2c.c. Left undefined - the
# SDK default - those loops are bare `while (result == kStatus_Success)`, so any
# bus condition that stops SCL from ever completing a STOP or freeing the TX
# FIFO hangs the core with no fault and no timeout.
#
# I3C_RETRY_TIMES is the same define for fsl_i3c.c and was missed when the
# others went in, which cost real bench time: a private write that the target
# never acknowledged left I3C_MasterWaitForTxReady() spinning on
# `while (txCount < byteCounts)` with no exit, and the controller stopped
# answering USB entirely. It looked like a crash and was a wait. Recovery meant
# reflashing between attempts, so every measurement that needed a write cost a
# programming cycle.
#
# Both spellings matter: fsl_i3c.h only falls back to 0 when neither
# I3C_RETRY_TIMES nor CONFIG_I3C_RETRY_TIMES is defined, and 0 is what selects
# the unbounded variant of each loop.
#
# A bus tool is exactly the program that meets those conditions: its whole job
# is to talk to hardware that may be stuck, absent or mis-clocked. It must
# always come back with an answer, even an error one, so an unbounded wait
# anywhere below the command loop is a defect rather than a tuning choice.
#
# 1000000 iterations is a handful of milliseconds at 240 MHz - far longer than
# any legitimate wait at bus rates up to 1 MHz, including a target that clock
# stretches, and far shorter than a host timeout.

# USB_DEVICE_CONFIG_LPM_L1 is not a link-power-management feature request - it
# is the only guard the SDK puts around BOS descriptor support, and BOS is what
# carries the Microsoft OS 2.0 platform capability that makes Windows bind
# WinUSB with nothing installed.
#
# Without it, usb_device_ch9.c has no branch for USB_DESCRIPTOR_TYPE_BOS at all,
# so a host's GET_DESCRIPTOR(BOS) never reaches the device callback and is
# answered as an unsupported request. The device then enumerates and sits there
# with no driver bound and no error naming the cause. It took several rounds of
# descriptor bisection to find, because every descriptor involved was correct -
# the request simply never arrived.
#
# It is a compile definition rather than a Kconfig setting because the symbol is
# absent from the generated usb_device_config.h entirely (not defined to 0), so
# the SDK's `#if defined(...) && (... > 0)` guards pick this up cleanly.

# The capture core's image, carried by the controller.
#
# Generated by scripts/mkcm7image.py from the capture build's .bin, so the
# controller can copy it into the CM7's ITCM and release that core. Optional on
# purpose: without it the bridge still builds and SNIFF:CM7 reports that this
# build carries no capture image, which is a far better failure than a stale
# blob being copied into ITCM and run.
#
# 34 KB of .rodata, which is why the bridge is built for the flexspi_nor
# (XIP) target - it does not fit alongside the code in 127 KB of TCM.
#
# Gated, not automatic. In the RAM target the initialiser for .data is stored in
# m_text, so a 34 KB array costs 34 KB of the 127 KB of TCM whether it is const
# or not - and the controller already fills that to 96%. The RAM build simply
# cannot carry the image, so asking it to would turn a working development build
# into a link error.
#
# The flexspi_nor target has 8 MB and carries it comfortably. So the embed is an
# explicit option that scripts/build.ps1 passes only for that target, and the RAM
# build keeps working with SNIFF:CM7 reporting that this build has no image.
#
option(BB_EMBED_CM7 "Embed the capture core image (needs the flexspi_nor target)" OFF)

set(BB_CM7_IMAGE ${BB_ROOT}/generated/bb_cm7_image.c)
if(BB_EMBED_CM7 AND EXISTS ${BB_CM7_IMAGE})
    mcux_add_source(SOURCES generated/bb_cm7_image.c BASE_PATH ${BB_ROOT})
    mcux_add_macro(CC "-DBB_HAVE_CM7_IMAGE=1")
    message(STATUS "BUSBRIDGE: embedding capture image ${BB_CM7_IMAGE}")
else()
    mcux_add_macro(CC "-DBB_HAVE_CM7_IMAGE=0")
    message(STATUS "BUSBRIDGE: no embedded capture image "
                   "(BB_EMBED_CM7=${BB_EMBED_CM7}); SNIFF:CM7 will report so")
endif()

# __USE_SHMEM compiles in the MPU region that makes the CM33 <-> CM7 mailbox
# non-cacheable on both cores; the matching linker symbol __use_shmem__ is set in
# the board port's reconfig.cmake, and both halves are needed. See the note there.

include(${BB_BOARD_DIR}/port/reconfig.cmake OPTIONAL)

mcux_convert_binary(BINARY ${APPLICATION_BINARY_DIR}/${MCUX_SDK_PROJECT_NAME}.bin)
```

## prj.conf
```kconfig
# Drivers this firmware needs from the SDK. Kept minimal on purpose: every
# component here is code in the image, and the STM32 build fitted in 62 KB.
CONFIG_MCUX_COMPONENT_driver.rgpio=y
CONFIG_MCUX_COMPONENT_driver.lpuart=y
CONFIG_MCUX_COMPONENT_driver.iomuxc=y
CONFIG_MCUX_COMPONENT_driver.cache_xcache=y
CONFIG_MCUX_COMPONENT_utility.debug_console_lite=y
CONFIG_MCUX_COMPONENT_driver.lpi2c=y
CONFIG_MCUX_COMPONENT_driver.lpspi=y
CONFIG_MCUX_COMPONENT_driver.i3c=y
CONFIG_MCUX_COMPONENT_driver.flexcan=y
CONFIG_MCUX_COMPONENT_driver.flexio=y
CONFIG_MCUX_COMPONENT_driver.netc=y
# USB device: select the EHCI controller and nothing else.
#
# EHCI is the high-speed controller; KHCI is full speed only and choosing it
# would cap the link at 12 Mbit/s regardless of what the descriptors claim.
#
# Only this one symbol is set. `device.stack`, `device.controller.driver`,
# `ehci_config_header` and `usb.phy` are all `select`ed by it and are not
# promptable - setting them directly is what made Kconfig refuse the first
# attempt. Let the dependency graph do its job.
# The entry point is the `usb.common_header` menuconfig, then the device half.
# `device.ehci`, `device.stack`, `device.controller.driver` and `usb.phy` all
# default on underneath and are NOT user-assignable - setting them directly is
# what made Kconfig refuse the first two attempts. Let the graph do its job.
CONFIG_MCUX_COMPONENT_middleware.usb.common_header=y
CONFIG_MCUX_COMPONENT_middleware.usb.device.common_header=y

# The EdgeLock Enclave base API is NOT enabled as a component here.
#
# devices/RT/RT1180/MIMXRT1189/drivers/fsl_ele_base_api.c is already in the
# build - the board's own init uses it - and enabling
# CONFIG_MCUX_COMPONENT_component.ele_base_api adds a second copy from
# components/ele_base_api/, which fails the link on duplicate symbols. The
# header is already on the include path, so including it is all that is needed.
```

## src/main.c
```c
/**
 * @file main.c
 * @brief Host transports and the command pump, for either profile.
 *
 * What an image does with the board's pins is bb_profile_*: the bridge profile
 * drives five buses from the host, the peripheral profile answers as a target
 * on them. Everything in this file is common to both - two host transports, one
 * command pump, a heartbeat.
 *
 * Two host transports are live at once and either can issue commands:
 *
 *   - the ST-LINK Virtual COM Port (USART3), which needs no firmware USB stack
 *     and works over the cable that powers the board;
 *   - the native USB device on the user USB-C connector (CN13), a vendor
 *     interface with bulk endpoints that Windows binds to WinUSB automatically.
 *
 * The bulk path is roughly a hundred times the raw bandwidth of the VCP and
 * costs one USB transaction per command instead of a UART round trip. Replies
 * follow whichever transport carried the command, which is what bb_io does.
 *
 * The main loop is deliberately a single-threaded command pump: bus
 * transactions are short and strictly request/response, so there is nothing to
 * gain from an RTOS and a lot of determinism to lose.
 */
#include "bb_board.h"
#include "bb_cmd.h"
#include "bb_console.h"
#include "bb_io.h"
#include "bb_profile.h"
#include "bb_usb.h"
#include "bb_version.h"

#define HEARTBEAT_MS  500u

/** Run one line from a transport, with replies routed back to it. */
static void dispatch(char *line, int status, bb_io_target_t from)
{
    if (status < 0 && status != -2) {
        return;
    }
    bb_io_select(from);
    bb_led_indicate(BB_LED_ACTIVITY, true);
    if (status == -2) {
        bb_reply_err(BB_ERR_TOO_LONG, "line-too-long");
    } else {
        bb_cmd_execute(line);
    }
    bb_led_indicate(BB_LED_ACTIVITY, false);
}

int main(void)
{
    /* Static rather than automatic: half a kilobyte of command line has no
     * business competing with the bus handlers for stack. */
    static char console_line[BB_CMD_MAX_LINE];
    static char usb_line[BB_CMD_MAX_LINE];
    uint32_t    last_beat = 0;

    bb_board_init();
    bb_console_init();
    bb_usb_init();
    bb_cmd_init();
    bb_profile_init();

    bb_io_select(BB_IO_CONSOLE);
    bb_console_printf("\r\n# %s %s (%s) on %s ready\r\n",
                      BB_PRODUCT, BB_VERSION, bb_profile_name, BB_BOARD);
    bb_console_printf("# %s\r\n", bb_profile_summary);
    bb_console_puts("# type HELP for the command list\r\n");

    for (;;) {
        dispatch(console_line,
                 bb_console_getline(console_line, sizeof console_line),
                 BB_IO_CONSOLE);

        if (bb_usb_ready()) {
            dispatch(usb_line,
                     bb_usb_getline(usb_line, sizeof usb_line),
                     BB_IO_USB);
        }

        bb_profile_poll();


        if (HAL_GetTick() - last_beat >= HEARTBEAT_MS) {
            last_beat = HAL_GetTick();
            bb_led_toggle(BB_LED_HEARTBEAT);
            bb_profile_tick();
        }
    }
}
```

## inc/bb_board.h
```c
/**
 * @file bb_board.h
 * @brief Board-independent hardware interface.
 *
 * The pin map, clock tree and peripheral choices live in
 * firmware/boards/<board>/board.h, selected by the build. This header is the
 * part every module can rely on regardless of which board it is: the pin
 * types, the LED and button API, the cycle counter, the published pin map.
 *
 * One board so far. The porting discipline from the STM32 tree is kept anyway -
 * three files under boards/<name>/ and nothing outside them - because that is
 * what made the third STM32 board cost nothing to add. Anything that reads like
 * a board fact belongs in the board header, not here.
 */
#ifndef BB_BOARD_H
#define BB_BOARD_H

#include "bb_hal.h"
#include <stdbool.h>
#include <stdint.h>

/* bb_pin_t is defined in bb_hal.h: on this part a pad is a mux register, a
 * mux mode, an input-select daisy chain and a pad-config register, not a
 * port/bit/AF triple. */

/**
 * @brief One entry of the published pin map.
 *
 * The silkscreen label and the connector are separate fields on purpose. A
 * label alone does not say which hole to put a wire in: the Arduino numbering
 * runs across four connectors in no particular order, so "D65" and "D28" are
 * on different ones, and guessing the connector from the label is exactly the
 * mistake that made a two-board link read as an open circuit.
 */
typedef struct {
    const char *signal;    /**< "i2c1.scl"                                  */
    const char *pin;       /**< MCU pin, "PB8"                              */
    const char *header;    /**< silkscreen label, "D15", or "-"             */
    const char *conn;      /**< connector and pin, "CN7-2", or "-" if not
                                brought out to one                          */
} bb_pinmap_t;

/**
 * @brief What the running silicon reports about itself.
 *
 * Read from the factory-programmed registers, so it describes the part in the
 * socket rather than the part this firmware was compiled for. The two disagree
 * exactly when the wrong image has been flashed, which is worth catching: the
 * pin map, and therefore every wiring decision made from it, belongs to the
 * board the build assumed.
 */
typedef struct {
    uint16_t dev_id;         /**< family id from OCOTP, 0x1186 for this part */
    uint16_t revision;       /**< DBGMCU REV_ID                              */
    uint16_t flash_kb;       /**< flash size the factory recorded            */
    uint16_t package;        /**< package code from OCOTP, raw and undecoded */
    uint16_t expect_dev_id;  /**< what the build expects, 0 if it says none  */
    bool     checked;        /**< false when the board declares no expectation */
    bool     matches;        /**< true when the silicon is what was expected */
} bb_silicon_t;

void bb_board_silicon(bb_silicon_t *out);

/* ---- the board ---------------------------------------------------------- */
/* Adding a board does not mean editing a chain here - there is no chain. The
 * build puts exactly one boards/<name>/ directory on the include path, and
 * that decides which definition below resolves. Configure with
 * -DBB_BOARD=<directory name>.
 *
 * The file is bb_board_def.h rather than board.h because the MCUXpresso SDK
 * ships its own board.h for this board, and two files of that name on one
 * include path is a coin flip resolved by search order. */
#include "bb_board_def.h"

#ifndef BB_BOARD_NAME
#  error "boards/<name>/bb_board_def.h did not define BB_BOARD_NAME - wrong board on the include path?"
#endif

/* Defaults for facts most boards do not need to state. */
#ifndef BB_CONSOLE_BAUD
/* Not a board property: the ST-LINK VCP runs at whatever both ends agree on,
 * and every host tool here defaults to this. */
#  define BB_CONSOLE_BAUD 115200U
#endif
#ifndef BB_I2C3_AVAILABLE
#  define BB_I2C3_AVAILABLE 1
#endif
#ifndef BB_I3C_PORT_COUNT
#  define BB_I3C_PORT_COUNT 1u
#endif

/* ---- User LEDs --------------------------------------------------------- */
/* The first three keep their roles on every board - green is the heartbeat,
 * yellow lights while a command runs, red means a fault - so the indications
 * mean the same thing wherever you are looking. A board with a fourth LED
 * exposes it as BB_LED_EXTRA. */
typedef enum {
    BB_LED_GREEN = 0,
    BB_LED_YELLOW,
    BB_LED_RED,
    BB_LED_EXTRA,
    BB_LED_MAX
} bb_led_t;

/** LEDs this board actually has. */
#define BB_LED_COUNT  BB_LED_COUNT_HW

/* What the firmware uses LEDs for, resolved to the LEDs a board has rather
 * than to fixed indices. BB_LED_MAX means "this board has nowhere to show it".
 *
 * A fault falls back to the first LED when there is no third one: the board is
 * already in trouble, and taking the heartbeat's LED to say so is a better
 * trade than saying nothing. Activity does not fall back - a one-LED board
 * blinking on every command would just look broken. */
#define BB_LED_HEARTBEAT  BB_LED_GREEN
#define BB_LED_ACTIVITY   ((BB_LED_COUNT > 1u) ? BB_LED_YELLOW : BB_LED_MAX)
#define BB_LED_FAULT      ((BB_LED_COUNT > 2u) ? BB_LED_RED : BB_LED_GREEN)

void bb_board_init(void);

/**
 * @brief Free-running cycle counter for sub-microsecond delays.
 *
 * Backed by TIM2 (32-bit, clocked at PCLK1) rather than DWT->CYCCNT.  CYCCNT
 * only runs while DEMCR.TRCENA is set, and a debugger clears that when it
 * detaches - which silently turns any CYCCNT-based delay loop into an infinite
 * one the moment you unplug the debugger.  A timer has no such dependency.
 */
uint32_t bb_cycles(void);

/** Frequency at which bb_cycles() advances, in Hz. */
uint32_t bb_cycle_hz(void);

/**
 * @brief Drive a LED on behalf of the host, and keep it.
 *
 * The LED stops being used for the heartbeat or anything else automatic until
 * bb_led_release() gives it back. Without that, a board with one LED cannot be
 * driven by the host at all: the heartbeat overwrites it twice a second.
 */
void     bb_led_set(bb_led_t led, bool on);

/** Give a LED back to the firmware's own use. */
void     bb_led_release(bb_led_t led);

/** True when the host has claimed this LED. */
bool     bb_led_claimed(bb_led_t led);

/**
 * @brief Drive a LED for the firmware's own indication.
 *
 * Does nothing for a LED the host has claimed, or one this board does not
 * have - so callers can name a role without checking whether it landed
 * anywhere.
 */
void     bb_led_indicate(bb_led_t led, bool on);
void     bb_led_toggle(bb_led_t led);
bool     bb_button_pressed(void);
uint32_t bb_uid_word(uint8_t index);

/* ---- pin helpers ------------------------------------------------------- */

/**
 * @brief Drive @p scl and @p sda as open-drain alternate-function pins.
 *
 * The internal pull-up is enabled so a bus with no external resistors still
 * idles high and is testable; it is far too weak (roughly 40 kOhm) for real
 * signalling, so fit 2.2k to 4.7k externals for anything above a slow crawl.
 */
void bb_pins_i2c(const bb_pin_t *scl, const bb_pin_t *sda);

/**
 * @brief Put the I3C controller's pins on port @p port (1-based).
 *
 * There is one I3C peripheral on both supported parts, so this chooses which
 * pin pair the bus appears on, not which controller to use. Boards with a
 * single pair ignore anything but port 1.
 *
 * I3C drives push-pull itself.  ST's sequence is to come up with the internal
 * pull-up so the bus reaches a valid idle high, then remove it.
 */
void bb_pins_i3c(unsigned port);

/** Pins of I3C port @p port, for reporting. NULL if there is no such port. */
const char *bb_i3c_port_pins(unsigned port);

/**
 * @brief The board's pin map, as published by SYS:PINS?.
 *
 * One table, next to the macros it describes, so the host tools and the GUI can
 * show the wiring without keeping their own copy of it. A pin that moves has to
 * move here too, and then everything downstream follows.
 */
const bb_pinmap_t *bb_pin_map(unsigned *count);

/**
 * @brief Hold the I3C port's pins at fixed levels, as push-pull outputs.
 *
 * A continuity aid, not a bus operation: it exists so a second board can be
 * asked "do you see this?" about a level rather than about an edge. Push-pull
 * so it needs no pull-up resistor to prove a wire.
 *
 * The next I3C command takes the pins back.
 */
void bb_pins_i3c_drive(unsigned port, bool scl_high, bool sda_high);

/**
 * @brief Let go of the I3C port's pins entirely: inputs, no pull.
 *
 * The state a board needs when it is listening rather than talking. An I3C
 * controller drives SCL push-pull, so two initialised controllers on one wire
 * fight each other, and the loser is whichever line you were trying to read.
 * A released pin contributes nothing to the bus.
 */
void bb_pins_i3c_free(unsigned port);

/**
 * @brief Choose whether bb_pins_i3c() leaves the internal pull-ups enabled.
 *
 * Off by default. See I3C:PULL: the internal pull-up is roughly 40 kOhm, which
 * is enough to hold a short bench wire high at low speed and nowhere near what
 * a real I3C bus needs. Takes effect the next time the pins are configured.
 */
void bb_pins_i3c_set_pull(bool on);

/**
 * @brief Reset any device the board has permanently wired to an I2C bus.
 *
 * Bus recovery clocks a target that is holding SDA. It cannot help a target
 * whose state machine is lost, and at least one device on the Discovery kit can
 * end up exactly there. Where the board has a reset line for such a device,
 * this pulses it; elsewhere it does nothing.
 *
 * @param bus 1-based I2C bus number
 * @return true if something was actually reset
 */
bool bb_board_reset_bus_devices(unsigned bus);

void bb_error_handler(const char *where);

#endif /* BB_BOARD_H */
```

## inc/bb_can.h
```c
/**
 * @file bb_can.h
 * @brief FlexCAN1 on the on-board transceiver.
 *
 * New to this project: the NUCLEO had no CAN transceiver, so the sniffer's CAN
 * decoder has never seen real traffic. Two board conditions have to hold before
 * frames appear - jumpers J44/J46 in position 1-2, and a header fitted to the
 * DNP connector J22. `CAN:CFG` reports the second in its reply, because a
 * missing connector looks exactly like a firmware fault.
 *
 * Listen-only is a hardware mode here, not a firmware convention: the receiver
 * acknowledges nothing and transmits nothing, so attaching to a live bus cannot
 * disturb it.
 */
#ifndef BB_CAN_H
#define BB_CAN_H

#include "bb_status.h"

void bb_can_init(void);

/** Drain the receive message buffer into the ring. Called from the poll hook. */
void bb_can_poll(void);

void bb_can_status(bb_status_t *out);

#endif /* BB_CAN_H */
```

## inc/bb_cmd.h
```c
/**
 * @file bb_cmd.h
 * @brief ASCII command protocol: tokeniser, dispatch table and reply helpers.
 *
 * One command per line, case-insensitive, colon-separated namespace:
 *
 *     I2C:WR 0x50 2 00 10          ->  OK 4B 5A
 *     ERR 5 nack-addr
 *
 * Every reply is exactly one line beginning with "OK" or "ERR <code> <text>",
 * which makes the host side a trivial state machine.
 */
#ifndef BB_CMD_H
#define BB_CMD_H

#include <stdbool.h>
#include <stddef.h>
#include <stdint.h>

#define BB_PAYLOAD_MAX   256u   /* bytes per single bus transfer */

/* A full 256-byte payload is 512 characters as one contiguous hex token, plus
 * the command word and its arguments - hence the line budget below.  The host
 * library sends large payloads in that compact form for exactly this reason.
 * Space-separated bytes are still accepted, up to BB_CMD_MAX_ARGS tokens. */
#define BB_CMD_MAX_LINE  1100u  /* console line buffer, incl. NUL */
#define BB_CMD_MAX_ARGS    80u

/* Error codes shared with the host library (see host/busbridge/client.py). */
#define BB_ERR_UNKNOWN_CMD   1
#define BB_ERR_ARGC          2
#define BB_ERR_NUMBER        3
#define BB_ERR_BUS_STATE     4
#define BB_ERR_NACK          5
#define BB_ERR_TIMEOUT       6
#define BB_ERR_HAL           7
#define BB_ERR_UNSUPPORTED   8
#define BB_ERR_TOO_LONG      9
#define BB_ERR_RANGE        10

typedef struct {
    const char *name;                       /**< full command word, upper case */
    uint8_t     min_args;
    uint8_t     max_args;                   /**< 0xFF = variadic */
    void      (*fn)(int argc, char **argv); /**< argv[0] is the command word */
    const char *usage;
} bb_cmd_t;

void bb_cmd_init(void);

/** Feed one complete line (without newline). Emits exactly one reply line. */
void bb_cmd_execute(char *line);

/* ---- reply helpers ----------------------------------------------------- */

/**
 * The most bytes one `bb_reply_ok_bytes` line may carry.
 *
 * A reply line has a hard length limit, and it is not this firmware's: the
 * host library reads a line into a 1200-byte buffer (BB_REPLY_MAX there). Each
 * byte costs three characters here - a space and two hex digits - after a
 * two-character "OK", so (1200 - 1 - 2) / 3 = 399 bytes is what fits.
 *
 * A command that offers more does not get a long line, it gets a cut one, and
 * for a command that advances a cursor - SNIFF:RAW:READ? is the one that does -
 * the bytes beyond the cut are not re-readable. They are gone. So the bound
 * belongs on what a command is willing to *promise*, not on what it prints.
 *
 * Stated as a number rather than derived from the host's constant because the
 * two live in different repositories; if that one ever grows, this is the line
 * to change and the comment that says why.
 */
#define BB_REPLY_BYTES_MAX  399u

/**
 * The longest reply line a command may build, in characters.
 *
 * A companion to BB_REPLY_BYTES_MAX above, for the commands that print tokens
 * rather than hex bytes. 1152 rather than the host's 1200 so the header, the
 * terminator and a partly-formatted token at the end all have room without
 * arithmetic at each call site.
 *
 * Note what this does NOT explain. SNIFF:TRACE? used to take the board down
 * at about fifty events - it would enumerate afterwards and refuse to open -
 * and the cause was a stack overflow in the peek that fed it, not the reply
 * length. That is written up at bb_trace_peek(). This bound was added while
 * chasing the wrong suspect and kept because it is worth having on its own
 * terms: a command that promises more than a line holds hands back a cut one,
 * and for a command that advances a cursor the cut part is gone.
 */
#define BB_REPLY_TEXT_MAX  1152u

void bb_reply_ok(void);
void bb_reply_okf(const char *fmt, ...) __attribute__((format(printf, 1, 2)));

/**
 * Reply with `len` bytes as hex.
 *
 * `len` must not exceed BB_REPLY_BYTES_MAX; more than that is reported as an
 * error instead of being sent, because a caller that overruns the line would
 * otherwise have its tail silently removed in transit.
 */
void bb_reply_ok_bytes(const uint8_t *data, size_t len);
void bb_reply_err(int code, const char *text);
void bb_reply_errf(int code, const char *fmt, ...) __attribute__((format(printf, 2, 3)));

/** Map a HAL status onto an error reply. Returns true if @p st was HAL_OK. */
bool bb_reply_hal(int st_hal, const char *what);

/* ---- argument parsing -------------------------------------------------- */
/** Accepts 0x/0X hex, 0b binary, or decimal. */
bool bb_parse_u32(const char *s, uint32_t *out);
bool bb_parse_u32_max(const char *s, uint32_t max, uint32_t *out);

/**
 * @brief Parse argv[first..argc-1] as a hex byte stream.
 *
 * Each token is an even number of hex digits with an optional 0x prefix, so
 * "DEADBEEF", "DE AD BE EF" and "0xDE 0xAD" are all four... two, four bytes
 * respectively.  Returns false on a malformed token or on overflow of @p cap.
 */
bool bb_parse_bytes(int argc, char **argv, int first, uint8_t *out, size_t cap, size_t *len);

/** Case-insensitive whole-token compare. */
bool bb_streq_ci(const char *a, const char *b);

/* Command tables contributed by the bus modules. */
extern const bb_cmd_t bb_cmd_sys[];
extern const bb_cmd_t bb_cmd_i2c[];
extern const bb_cmd_t bb_cmd_i3c[];
extern const bb_cmd_t bb_cmd_spi[];
extern const bb_cmd_t bb_cmd_mdio[];
extern const bb_cmd_t bb_cmd_uart[];
/* New on this board: the STM32 had no CAN transceiver to drive. */
extern const bb_cmd_t bb_cmd_can[];
extern const bb_cmd_t bb_cmd_ee[];
/* Phase 6's bounded slice: the on-board PHYs, which only NETC's MDIO reaches. */
extern const bb_cmd_t bb_cmd_net[];
extern const bb_cmd_t bb_cmd_sniff[];

#endif /* BB_CMD_H */
```

## inc/bb_console.h
```c
/**
 * @file bb_console.h
 * @brief Host-facing console on USART3 / ST-LINK Virtual COM Port.
 *
 * Phase 1 transport for the command protocol.  RX is interrupt-driven into a
 * ring buffer so that a slow command handler cannot lose incoming characters;
 * TX is polled, which is fine for request/response traffic and keeps fault
 * reporting possible with interrupts off.
 */
#ifndef BB_CONSOLE_H
#define BB_CONSOLE_H

#include <stdarg.h>
#include <stdbool.h>
#include <stddef.h>
#include <stdint.h>

void bb_console_init(void);

void bb_console_write(const void *data, size_t len);
void bb_console_puts(const char *s);
void bb_console_printf(const char *fmt, ...) __attribute__((format(printf, 1, 2)));

/** Polled, interrupt-free write for fault paths. */
void bb_console_emergency_print(const char *s);

/**
 * @brief Non-blocking line reader.
 * @param buf  destination, NUL-terminated on success
 * @param cap  size of @p buf
 * @return length of the line, or -1 when no complete line is available yet.
 *         A line too long for @p cap is reported as an overflow error and
 *         discarded.
 */
int  bb_console_getline(char *buf, size_t cap);

/** Raw byte access, used by transparent UART bridge mode. -1 when empty. */
int  bb_console_getchar(void);

void bb_console_set_echo(bool enable);
bool bb_console_echo(void);

/** Characters lost to ring-buffer overrun since boot. */
uint32_t bb_console_rx_overruns(void);

/** Called from the USART3 interrupt vector. */
void bb_console_irq(void);

#endif /* BB_CONSOLE_H */
```

## inc/bb_ee.h
```c
/**
 * @file bb_ee.h
 * @brief The one kilobyte every target on this board serves.
 *
 * The point of the peripheral profile is that I3C, I2C, SPI and MDIO are four
 * doors into the *same* array. Write 0xAA at 0x100 over SPI, read it back over
 * I3C, see it in the host's EE:RD - that is a test worth running, and it is
 * only worth running if there is exactly one copy of the data.
 *
 * So this module owns the bytes and the counters, and knows nothing about any
 * bus. Each target back-end translates its own protocol into bb_ee_read() and
 * bb_ee_write() calls and nothing more.
 *
 * RAM-backed, deliberately. A real EEPROM is non-volatile, but a device under
 * test that comes up with known contents after every reset is worth more than
 * one that remembers a previous experiment - and flash wear from a write loop
 * is a poor way to discover that. EE:SAVE is not offered for the same reason.
 */
#ifndef BB_EE_H
#define BB_EE_H

#include "bb_status.h"
#include <stdbool.h>
#include <stddef.h>
#include <stdint.h>

/** 1 KB, so a 16-bit address covers it with room to spare. */
#define BB_EE_SIZE      1024u

/** Address mask. Access wraps rather than faulting, as a real EEPROM does. */
#define BB_EE_MASK      (BB_EE_SIZE - 1u)

/** Which door a byte came through. Counted per interface so that "did my write
 *  land?" has an answer that does not depend on reading the data back. */
typedef enum {
    BB_EE_IF_HOST = 0,   /**< the USB/console EE: commands */
    BB_EE_IF_I2C,
    BB_EE_IF_I3C,
    BB_EE_IF_SPI,
    BB_EE_IF_MDIO,
    BB_EE_IF_COUNT
} bb_ee_if_t;

void bb_ee_init(void);

/** Read one byte. @p addr wraps to the array. */
uint8_t bb_ee_read(bb_ee_if_t from, uint16_t addr);

/** Write one byte, unless this interface is write-protected. */
void    bb_ee_write(bb_ee_if_t from, uint16_t addr, uint8_t value);

/** Bulk access for the host commands, which have the whole array in view. */
void    bb_ee_read_block(bb_ee_if_t from, uint16_t addr, uint8_t *out, size_t len);
void    bb_ee_write_block(bb_ee_if_t from, uint16_t addr, const uint8_t *in, size_t len);

/**
 * @brief Read a byte without counting it.
 *
 * For a back-end's own bookkeeping - the I3C target preloads a window of bytes
 * it may never send, and counting those as reads would report traffic the
 * controller never performed.
 */
uint8_t bb_ee_peek(uint16_t addr);

/**
 * @brief Add to an interface's read count without touching the data.
 *
 * Only the I3C target needs this, and only because it learns after the fact how
 * many bytes left the peripheral - see bb_ee_i3c.c. Every other back-end counts
 * as it goes.
 */
void    bb_ee_note_bytes_read(bb_ee_if_t from, uint16_t count);

/** Fill every byte with @p value. */
void    bb_ee_fill(uint8_t value);

/**
 * @brief Restore the boot pattern: ee[i] = i & 0xFF.
 *
 * Not zeros. A ramp makes an off-by-one address pointer visible at a glance -
 * the byte at 0x123 reads 0x23 - which zeros cannot do, and that is exactly the
 * bug a bus test is looking for.
 */
void    bb_ee_pattern(void);

/** Refuse writes from one interface, to prove a read-only path stays read-only. */
void    bb_ee_protect(bb_ee_if_t which, bool on);
bool    bb_ee_protected(bb_ee_if_t which);

/** Per-interface activity. Zeroed by bb_ee_clear_stats(). */
typedef struct {
    uint32_t reads;          /**< bytes read          */
    uint32_t writes;         /**< bytes written       */
    uint32_t transactions;   /**< framed bus accesses */
    uint32_t rejected;       /**< writes refused by the protect flag */
    uint16_t last_addr;      /**< address of the last byte touched   */
} bb_ee_stats_t;

/** A back-end calls this once per framed bus transaction, for the counter. */
void                 bb_ee_note_transaction(bb_ee_if_t from);
const bb_ee_stats_t *bb_ee_stats(bb_ee_if_t which);
void                 bb_ee_clear_stats(void);

/** Short name for a reply, e.g. "i2c". */
const char *bb_ee_if_name(bb_ee_if_t which);

void bb_ee_status(bb_status_t *out);

#endif /* BB_EE_H */
```

## inc/bb_ee_ports.h
```c
/**
 * @file bb_ee_ports.h
 * @brief The four target back-ends of the peripheral profile.
 *
 * Each one translates its own bus protocol into bb_ee_read()/bb_ee_write() and
 * owns nothing else. They are listed together here because the profile file has
 * to start them and the vectors have to reach them; they do not call each other,
 * with one exception - the I2C target asks the I3C target whether it is using
 * the shared pins, because on a 64-pin part that is a real conflict and a silent
 * bus is a bad way to find out.
 */
#ifndef BB_EE_PORTS_H
#define BB_EE_PORTS_H

#include "bb_cmd.h"
#include "bb_status.h"
#include <stdbool.h>
#include <stddef.h>

/* ---- I2C target --------------------------------------------------------- */
void bb_ee_i2c_init(void);
void bb_ee_i2c_ev_irq(unsigned bus);      /**< bus is 0-based */
void bb_ee_i2c_er_irq(unsigned bus);
void bb_ee_i2c_describe(char *out, size_t cap);
void bb_ee_i2c_status(bb_status_t *out);

/* ---- I3C target --------------------------------------------------------- */
void bb_ee_i3c_init(void);
void bb_ee_i3c_ev_irq(void);
void bb_ee_i3c_er_irq(void);
bool bb_ee_i3c_enabled(void);
void bb_ee_i3c_describe(char *out, size_t cap);
void bb_ee_i3c_status(bb_status_t *out);
/** Serviced from the command pump; the other three run from interrupts. */
void bb_ee_i3c_poll(void);

/* ---- SPI slave ---------------------------------------------------------- */
void bb_ee_spi_init(void);
void bb_ee_spi_irq(void);
void bb_ee_spi_cs_edge(void);
/* Polled on this board: RGPIO edge routing for the CS pad is not set up, so the
 * frame boundary is sampled rather than interrupted on. A frame shorter than
 * the poll interval is missed, and bb_ee_spi_describe() reports cs=polled so
 * that limitation stays visible rather than being assumed away. */
void bb_ee_spi_poll(void);
void bb_ee_spi_describe(char *out, size_t cap);
void bb_ee_spi_status(bb_status_t *out);
/** Which EXTI line the board's chip select pin is on. */
unsigned bb_ee_spi_cs_line(void);

/* ---- MDIO slave --------------------------------------------------------- */
void bb_ee_mdio_init(void);
void bb_ee_mdio_mdc_edge(void);
void bb_ee_mdio_describe(char *out, size_t cap);
void bb_ee_mdio_status(bb_status_t *out);
/** Which EXTI line the board's MDC pin is on. */
unsigned bb_ee_mdio_mdc_line(void);

/**
 * @brief One EXTI line fired.
 *
 * All sixteen vectors land here rather than the two this profile happens to
 * need being named in every board header. Which line belongs to the SPI chip
 * select and which to MDC is a board fact already in the pin map, so asking the
 * board for a vector name as well would be a third place to keep in step.
 */
void bb_ee_exti(unsigned line);

/* ---- command tables ----------------------------------------------------- */
extern const bb_cmd_t bb_cmd_ee[];
extern const bb_cmd_t bb_cmd_ee_i2c[];
extern const bb_cmd_t bb_cmd_ee_i3c[];
extern const bb_cmd_t bb_cmd_ee_spi[];
extern const bb_cmd_t bb_cmd_ee_mdio[];

#endif /* BB_EE_PORTS_H */
```

## inc/bb_i2c.h
```c
/**
 * @file bb_i2c.h
 * @brief LPI2C controllers — three independent buses.
 *
 * Bus 1 is LPI2C1 on D0/D1, bus 2 is LPI2C2 on the motor connector J3, bus 3 is
 * LPI2C3 on the Arduino I2C position D14/D15. Commands act on whichever bus
 * `I2C:BUS` selected; every bus keeps its own frequency, so selecting one never
 * disturbs another.
 *
 * Two board facts shape this and are worth knowing before wiring anything:
 *
 *   - Three buses, not the STM32's four. LPI2C6 reaches no connector on this
 *     package and LPI2C2 only reaches J3. `I2C:PORTS?` reports the truth.
 *   - Bus 1 is off by default. Its pads are the MCU-Link console. Enabling it
 *     means moving jumpers J41/J43 and building with `BB_I2C1_ENABLE=1`, which
 *     costs the console. Until then it reports itself unavailable with the
 *     reason, rather than accepting transfers that go nowhere.
 *
 * The default selection is bus 3, not bus 1 as on the STM32 - otherwise every
 * fresh board would refuse its first transfer.
 */
#ifndef BB_I2C_H
#define BB_I2C_H

#include <stdbool.h>
#include <stdint.h>

void bb_i2c_init(void);

/*
 * No interrupt vectors here.
 *
 * The STM32 build needed bb_i2c_ev_irq/bb_i2c_er_irq because ST's sequential
 * (repeated-start) API is interrupt-driven: a write-then-read had to be
 * assembled across two callbacks. LPI2C carries the sub-address in the transfer
 * itself and performs the repeated START in hardware, so a register read is one
 * blocking call and there is nothing for a vector to do.
 *
 * They are gone rather than stubbed: a vector that exists and does nothing
 * invites someone to wire it up.
 */

#endif /* BB_I2C_H */
```

## inc/bb_i2c_timing.h
```c
/**
 * @file bb_i2c_timing.h
 * @brief The I2C peripheral's TIMINGR register, computed rather than guessed.
 */
#ifndef BB_I2C_TIMING_H
#define BB_I2C_TIMING_H

#include <stdbool.h>
#include <stdint.h>

/** Every I2C kernel clock on this board is HSI; see bb_board.c. */
#define BB_I2C_KERNEL_HZ   64000000UL

/**
 * @brief TIMINGR for a bus running at @p hz.
 *
 * A target uses the same value as a controller would for the fastest bus it
 * expects to sit on: it ignores SCLL and SCLH, which it does not drive, and
 * takes SDADEL and SCLDEL, which it does.
 */
uint32_t bb_i2c_timingr(uint32_t hz);

#endif /* BB_I2C_TIMING_H */
```

## inc/bb_i3c.h
```c
/**
 * @file bb_i3c.h
 * @brief I3C1 in either role, controller or target, on the board's own I3C
 *        pins. Not shared with I2C1 any more; see bb_board.h for the pins,
 *        which differ per board.
 */
#ifndef BB_I3C_H
#define BB_I3C_H

void bb_i3c_init(void);

/*
 * Service anything the bus raised on its own - an in-band interrupt or a
 * hot-join. Called from the profile poll, because a target does not wait for a
 * host command before asking for attention.
 */
void bb_i3c_poll(void);

#include <stdbool.h>
#include <stddef.h>
#include <stdint.h>

/** Release the peripheral so I2C can take the pins. Called by the arbiter. */
void bb_i3c_release(void);

/** GPDMA channel interrupt for the target's transmit path. */
void bb_i3c_dma_irq(void);

/**
 * @brief Whether the I3C peripheral currently owns its pins.
 *
 * Asked by the sniffer, not by anything doing I3C. When the taps are jumpered
 * across to this board's own I3C pins - the usual way to watch your own
 * traffic - a configured controller drives the very wires the self test wants
 * to drive, and the test fails for a reason that has nothing to do with the
 * decoder. Knowing that lets the failure say so.
 */
bool bb_i3c_configured(void);

void bb_i3c_ev_irq(void);
void bb_i3c_er_irq(void);

/* ---- driving the target from firmware rather than from a host ------------ */
/* The bridge profile arms target replies from I3C:TGT:TX and drains received
 * bytes with I3C:TGT:RX?, one command at a time. The peripheral profile has no
 * host in the loop - an EEPROM answers a read nobody prepared it for - so the
 * same machinery is available directly.
 *
 * Everything below is target-role only and returns false or zero otherwise. */

/** Put the peripheral into the target role, rebuilt from scratch. */
bool bb_i3c_tgt_begin(void);

/** Load @p len bytes for the controller's next private read. */
bool bb_i3c_tgt_arm(const uint8_t *data, size_t len);

/** True while a loaded reply has not been read. */
bool bb_i3c_tgt_armed(void);

/**
 * @brief How many of the armed bytes the controller actually clocked out.
 *
 * From the DMA channel's remaining count. An auto-incrementing address pointer
 * must advance by this and not by the length that was armed: a controller that
 * reads four bytes of a thirty-two byte arm has moved the pointer four.
 */
uint16_t bb_i3c_tgt_tx_consumed(void);

/** Completed private writes seen. A change means a write frame ended. */
uint32_t bb_i3c_tgt_write_frames(void);

/** Take received bytes out of the ring. Returns how many. */
size_t bb_i3c_tgt_take(uint8_t *out, size_t max);

/** The dynamic address ENTDAA gave this target, or 0 if it has none yet. */
uint8_t bb_i3c_tgt_address(void);

#endif /* BB_I3C_H */
```
